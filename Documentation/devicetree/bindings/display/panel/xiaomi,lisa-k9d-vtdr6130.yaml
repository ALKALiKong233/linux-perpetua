## Documentation/devicetree/bindings/display/panel/xiaomi,lisa-k9d-vtdr6130.yaml
```yaml
# SPDX-License-Identifier: (GPL-2.0-only OR BSD-2-Clause)
%YAML 1.2
---
$id: http://devicetree.org/schemas/display/panel/xiaomi,lisa-k9d-vtdr6130.yaml#
$schema: http://devicetree.org/meta-schemas/core.yaml#

title: Xiaomi Lisa K9D VTDR6130 AMOLED DSI panel

maintainers:
  - Oleksii Onchul <oleksiionchul@gmail.com>

allOf:
  - $ref: panel-common.yaml#

properties:
  compatible:
    const: xiaomi,lisa-k9d-vtdr6130

  reg:
    maxItems: 1

  vddio-supply: true
  vci-supply: true
  dvdd-supply: true
  reset-gpios: true
  port: true

required:
  - compatible
  - reg
  - vddio-supply
  - vci-supply
  - dvdd-supply
  - reset-gpios
  - port

additionalProperties: false

examples:
  - |
    #include <dt-bindings/gpio/gpio.h>

    dsi {
        #address-cells = <1>;
        #size-cells = <0>;

        panel@0 {
            compatible = "xiaomi,lisa-k9d-vtdr6130";
            reg = <0>;

            reset-gpios = <&tlmm 44 GPIO_ACTIVE_LOW>;
            vddio-supply = <&vreg_l12c_1p8>;
            vci-supply = <&vreg_l13c_3p0>;
            dvdd-supply = <&display_panel_dvdd>;

            port {
                panel_in: endpoint {
                    remote-endpoint = <&dsi0_out>;
                };
            };
        };
    };
...
```

## Documentation/devicetree/bindings/input/awinic,aw8624.yaml
```yaml
# SPDX-License-Identifier: (GPL-2.0-only OR BSD-2-Clause)
%YAML 1.2
---
$id: http://devicetree.org/schemas/input/awinic,aw8624.yaml#
$schema: http://devicetree.org/meta-schemas/core.yaml#

title: Awinic AW8624 LRA Haptic IC

maintainers:
  - Oleksii Onchul <oleksiionchul@gmail.com>

properties:
  compatible:
    const: awinic,aw8624

  reg:
    maxItems: 1

  reset-gpios:
    maxItems: 1
    description: Active-low hardware reset.

  interrupts:
    maxItems: 1

required:
  - compatible
  - reg
  - reset-gpios
  - interrupts

additionalProperties: false

examples:
  - |
    #include <dt-bindings/gpio/gpio.h>
    #include <dt-bindings/interrupt-controller/irq.h>

    i2c {
        #address-cells = <1>;
        #size-cells = <0>;

        vibrator@5a {
            compatible = "awinic,aw8624";
            reg = <0x5a>;
            interrupt-parent = <&tlmm>;
            interrupts = <18 IRQ_TYPE_EDGE_FALLING>;
            reset-gpios = <&tlmm 35 GPIO_ACTIVE_LOW>;
        };
    };
...
```
